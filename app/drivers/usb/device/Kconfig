## app/drivers/usb/device/Kconfig
```kconfig
# Copyright (c) 2023 XiNGRZ
# SPDX-License-Identifier: Apache-2.0

menuconfig USB_DEVICE_DRIVER
	bool "Additional USB device controller drivers"

if USB_DEVICE_DRIVER

config USB_DC_ESP32SX
	bool "USB device controller driver for ESP32-SX series"
	default y
	depends on DT_HAS_ESPRESSIF_ESP32_USB_ENABLED

endif # USB_DEVICE_DRIVER
```

## app/west.yml
```yaml
# Copyright (c) 2023 XiNGRZ
# SPDX-License-Identifier: Apache-2.0

manifest:
  projects:
    - name: zephyr
      url: https://github.com/zephyrproject-rtos/zephyr.git
      revision: zephyr-v3.3.0
      clone-depth: 1
      import:
        name-blocklist:
          - ci-tools
          - hal_altera
          - hal_cypress
          - hal_infineon
          - hal_microchip
          - hal_nxp
          - hal_openisa
          - hal_silabs
          - loramac-node
          - mcuboot
          - mcumgr
          - net-tools
          - openthread
          - edtt
          - trusted-firmware-m
          - sof
```
