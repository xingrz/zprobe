/*
 * Copyright (c) 2023 XiNGRZ
 * SPDX-License-Identifier: Apache-2.0
 */

/dts-v1/;
#include "common.dtsi"

/ {
	model = "MuseLab nanoDAP-HS interface";
	compatible = "muselab,nanodap_hs_if", "atmel,sam3u2c", "atmel,sam3u";

	chosen {
		zephyr,code-partition = &code_partition;
	};
};
