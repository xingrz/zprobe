/*
 * Copyright (c) 2023 XiNGRZ
 * SPDX-License-Identifier: Apache-2.0
 */

/dts-v1/;
#include "stm32_bluepill.dtsi"

/ {
	model = "STM32 BluePill Bootloader";
	compatible = "zprobe,stm32_bluepill_bl", "st,stm32f103";

	chosen {
		zephyr,code-partition = &bootloader_partition;
		zprobe,boot-partition = &code_partition;
	};
};
