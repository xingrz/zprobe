## app/Kconfig.usb
```kconfig
# Copyright (c) 2023 XiNGRZ
# SPDX-License-Identifier: Apache-2.0

menu "USB"
	depends on USB_DEVICE_STACK

if USB_DEVICE_STACK

config USB_DEVICE_VID
	default 0x0d28

config USB_DEVICE_PID
	default 0x0204

config USB_DEVICE_MANUFACTURER
	default "XiNGRZ"

config USB_DEVICE_PRODUCT
	default "Zprobe CMSIS-DAP"

config USB_DEVICE_SN
	default "000000000000000000000000000000000000000000000000"

config USB_COMPOSITE_DEVICE
	default y

endif # USB_DEVICE_STACK

if ZPROBE_INTERFACE
rsource "Kconfig.usb.cdc_acm"
rsource "Kconfig.usb.cmsis_dap"
endif # ZPROBE_INTERFACE

endmenu
```

## app/Kconfig.usb.cdc_acm
```kconfig
# Copyright (c) 2023 XiNGRZ
# SPDX-License-Identifier: Apache-2.0

menuconfig ZPROBE_CDC_ACM
	bool "USB CDC-ACM"
	depends on USB_DEVICE_STACK
	depends on DT_HAS_ZEPHYR_CDC_ACM_UART_ENABLED
	default y if DT_HAS_ZPROBE_USB_CDC_ACM_ENABLED
	select SERIAL
	select USB_CDC_ACM
	select UART_LINE_CTRL
	select CDC_ACM_DTE_RATE_CALLBACK_SUPPORT
	help
	  Enable bridge between UART and USB CDC-ACM

if ZPROBE_CDC_ACM

config ZPROBE_CDC_ACM_RING_BUF_SIZE
	int
	default 128

endif # ZPROBE_CDC_ACM
```

## app/Kconfig.usb.cmsis_dap
```kconfig
# Copyright (c) 2023 XiNGRZ
# SPDX-License-Identifier: Apache-2.0

menuconfig ZPROBE_CMSIS_DAP_V2
	bool "USB CMSIS-DAP v2"
	depends on USB_DEVICE_STACK
	default y if HAS_SWDIO
	select CMSIS_DAP
	help
	  Enable USB interface for CMSIS-DAP v2

if ZPROBE_CMSIS_DAP_V2

module = ZPROBE_CMSIS_DAP
module-str = zprobe_cmsis_dap
source "subsys/logging/Kconfig.template.log_config"

endif # ZPROBE_CMSIS_DAP_V2
```

## app/boards/arm/nanodap_hs/Kconfig.board
```kconfig
# Copyright (c) 2023 XiNGRZ
# SPDX-License-Identifier: Apache-2.0

config BOARD_NANODAP_HS_BL
	bool "MuseLab nanoDAP-HS bootloader"
	depends on SOC_PART_NUMBER_SAM3U2C

config BOARD_NANODAP_HS_IF
	bool "MuseLab nanoDAP-HS interface"
	depends on SOC_PART_NUMBER_SAM3U2C
```

## app/boards/arm/nanodap_hs/Kconfig.defconfig
```kconfig
# Copyright (c) 2023 XiNGRZ
# SPDX-License-Identifier: Apache-2.0

if BOARD_NANODAP_HS_BL

config BOARD
	default "nanodap_hs_bl"

choice ZPROBE_APP
	default ZPROBE_BOOTLOADER
endchoice # ZPROBE_APP

endif # BOARD_NANODAP_HS_BL

if BOARD_NANODAP_HS_IF

config BOARD
	default "nanodap_hs_if"

choice ZPROBE_APP
	default ZPROBE_INTERFACE
endchoice # ZPROBE_APP

endif # BOARD_NANODAP_HS_IF
```

## app/boards/arm/nanodap_hs/nanodap_hs_bl_defconfig
```kconfig
# Copyright (c) 2023 XiNGRZ
# SPDX-License-Identifier: Apache-2.0

CONFIG_BOARD_NANODAP_HS_BL=y

CONFIG_SOC_SERIES_SAM3U=y
CONFIG_SOC_PART_NUMBER_SAM3U2C=y
CONFIG_CLOCK_CONTROL=y
CONFIG_PINCTRL=y
```

## app/boards/arm/nanodap_hs/nanodap_hs_if_defconfig
```kconfig
# Copyright (c) 2023 XiNGRZ
# SPDX-License-Identifier: Apache-2.0

CONFIG_BOARD_NANODAP_HS_IF=y

CONFIG_SOC_SERIES_SAM3U=y
CONFIG_SOC_PART_NUMBER_SAM3U2C=y
CONFIG_CLOCK_CONTROL=y
CONFIG_PINCTRL=y

CONFIG_USB_DEVICE_STACK=y
```

## app/boards/arm/stm32_bluepill/Kconfig.board
```kconfig
# Copyright (c) 2023 XiNGRZ
# SPDX-License-Identifier: Apache-2.0

config BOARD_STM32_BLUEPILL_BL
	bool "STM32 BluePill Bootloader"
	depends on SOC_STM32F103XB

config BOARD_STM32_BLUEPILL_IF
	bool "STM32 BluePill Interface"
	depends on SOC_STM32F103XB
```

## app/boards/arm/stm32_bluepill/Kconfig.defconfig
```kconfig
# Copyright (c) 2023 XiNGRZ
# SPDX-License-Identifier: Apache-2.0

if BOARD_STM32_BLUEPILL_BL

config BOARD
	default "stm32_bluepill_bl"

choice ZPROBE_APP
	default ZPROBE_BOOTLOADER
endchoice # ZPROBE_APP

endif # BOARD_STM32_BLUEPILL_BL

if BOARD_STM32_BLUEPILL_IF

config BOARD
	default "stm32_bluepill_if"

choice ZPROBE_APP
	default ZPROBE_INTERFACE
endchoice # ZPROBE_APP

endif # BOARD_STM32_BLUEPILL_IF
```

## app/boards/arm/stm32_bluepill/stm32_bluepill_bl_defconfig
```kconfig
# Copyright (c) 2023 XiNGRZ
# SPDX-License-Identifier: Apache-2.0

CONFIG_BOARD_STM32_BLUEPILL_BL=y

CONFIG_SOC_SERIES_STM32F1X=y
CONFIG_SOC_STM32F103XB=y
CONFIG_CLOCK_CONTROL=y
CONFIG_PINCTRL=y

CONFIG_USE_DT_CODE_PARTITION=y
CONFIG_USB_DEVICE_STACK=y
```

## app/boards/arm/stm32f103/Kconfig.board
```kconfig
# Copyright (c) 2023 XiNGRZ
# SPDX-License-Identifier: Apache-2.0

config BOARD_STM32F103_BL
	bool "Generic STM32F103 bootloader"
	depends on SOC_STM32F103XB

config BOARD_STM32F103_IF
	bool "Generic STM32F103 interface"
	depends on SOC_STM32F103XB
```

## app/boards/arm/stm32f103/Kconfig.defconfig
```kconfig
# Copyright (c) 2023 XiNGRZ
# SPDX-License-Identifier: Apache-2.0

if BOARD_STM32F103_BL

config BOARD
	default "stm32f103_bl"

choice ZPROBE_APP
	default ZPROBE_BOOTLOADER
endchoice # ZPROBE_APP

endif # BOARD_STM32F103_BL

if BOARD_STM32F103_IF

config BOARD
	default "stm32f103_if"

choice ZPROBE_APP
	default ZPROBE_INTERFACE
endchoice # ZPROBE_APP

endif # BOARD_STM32F103_IF
```

## app/boards/arm/stm32f103/stm32f103_bl_defconfig
```kconfig
# Copyright (c) 2023 XiNGRZ
# SPDX-License-Identifier: Apache-2.0

CONFIG_BOARD_STM32F103_BL=y

CONFIG_SOC_SERIES_STM32F1X=y
CONFIG_SOC_STM32F103XB=y
CONFIG_CLOCK_CONTROL=y
CONFIG_PINCTRL=y

CONFIG_USB_DEVICE_STACK=y
```

## app/boards/arm/stm32f103/stm32f103_if_defconfig
```kconfig
# Copyright (c) 2023 XiNGRZ
# SPDX-License-Identifier: Apache-2.0

CONFIG_SOC_SERIES_STM32F1X=y
CONFIG_SOC_STM32F103XB=y
CONFIG_CLOCK_CONTROL=y
CONFIG_PINCTRL=y
```

## app/boards/arm/stm32h730/Kconfig.board
```kconfig
# Copyright (c) 2023 XiNGRZ
# SPDX-License-Identifier: Apache-2.0

config BOARD_STM32H730_BL
	bool "Generic STM32H730 bootloader"
	depends on SOC_STM32H730XXQ

config BOARD_STM32H730_IF
	bool "Generic STM32H730 interface"
	depends on SOC_STM32H730XXQ
```

## app/boards/arm/stm32h730/Kconfig.defconfig
```kconfig
# Copyright (c) 2023 XiNGRZ
# SPDX-License-Identifier: Apache-2.0

if BOARD_STM32H730_BL

config BOARD
	default "stm32h730_bl"

choice ZPROBE_APP
	default ZPROBE_BOOTLOADER
endchoice # ZPROBE_APP

endif # BOARD_STM32H730_BL

if BOARD_STM32H730_IF

config BOARD
	default "stm32h730_if"

choice ZPROBE_APP
	default ZPROBE_INTERFACE
endchoice # ZPROBE_APP

endif # BOARD_STM32H730_IF
```

## app/boards/arm/stm32h730/stm32h730_if_defconfig
```kconfig
# Copyright (c) 2023 XiNGRZ
# SPDX-License-Identifier: Apache-2.0

CONFIG_BOARD_STM32H730_IF=y

CONFIG_SOC_SERIES_STM32H7X=y
CONFIG_SOC_STM32H730XXQ=y
CONFIG_POWER_SUPPLY_DIRECT_SMPS=y
CONFIG_ARM_MPU=y
CONFIG_HW_STACK_PROTECTION=y
CONFIG_CLOCK_CONTROL=y
CONFIG_PINCTRL=y

CONFIG_USB_DEVICE_STACK=y
```

## app/boards/xtensa/esp32s2_devkitc/Kconfig.board
```kconfig
# Copyright (c) 2023 XiNGRZ
# SPDX-License-Identifier: Apache-2.0

config BOARD_ESP32S2_DEVKITC_IF
	bool "Generic ESP32-S2-DevKitC-1 interface"
	depends on SOC_ESP32S2
```

## app/boards/xtensa/esp32s2_devkitc/Kconfig.defconfig
```kconfig
# Copyright (c) 2023 XiNGRZ
# SPDX-License-Identifier: Apache-2.0

if BOARD_ESP32S2_DEVKITC_IF

config BOARD
	default "esp32s2_devkitc_if"

choice ZPROBE_APP
	default ZPROBE_INTERFACE
endchoice # ZPROBE_APP

endif # BOARD_ESP32S2_DEVKITC_IF
```

## app/boards/xtensa/esp32s2_devkitc/esp32s2_devkitc_if_defconfig
```kconfig
# Copyright (c) 2023 XiNGRZ
# SPDX-License-Identifier: Apache-2.0

CONFIG_BOARD_ESP32S2_DEVKITC_IF=y

CONFIG_SOC_ESP32S2=y
CONFIG_CLOCK_CONTROL=y

CONFIG_BOOTLOADER_ESP_IDF=y

CONFIG_GEN_ISR_TABLES=y
CONFIG_GEN_IRQ_VECTOR_TABLE=n

CONFIG_XTENSA_USE_CORE_CRT1=n
CONFIG_XTENSA_RESET_VECTOR=n
```

## app/cmsis_dap/Kconfig
```kconfig
# Copyright (c) 2023 XiNGRZ
# SPDX-License-Identifier: Apache-2.0

menu "CMSIS-DAP"

config CMSIS_DAP
	bool "ARM CMSIS Version 5"

if CMSIS_DAP

config CMSIS_DAP_SWD
	bool "Enable Serial Wire Debug (SWD) communication mode"
	default y

module = CMSIS_DAP
module-str = cmsis_dap
source "subsys/logging/Kconfig.template.log_config"

endif # CMSIS_DAP

endmenu
```

## app/drivers/swdio/Kconfig
```kconfig
# Copyright (c) 2023 XiNGRZ
# SPDX-License-Identifier: Apache-2.0

rsource "Kconfig.bitbang"

config HAS_SWDIO
	bool

module = SWDIO
module-str = swdio
source "subsys/logging/Kconfig.template.log_config"
```

## app/drivers/swdio/Kconfig.bitbang
```kconfig
# Copyright (c) 2023 XiNGRZ
# SPDX-License-Identifier: Apache-2.0

DT_COMPAT_ZPROBE_SWDIO_BITBANG := zprobe,swdio-bitbang

config SWDIO_BITBANG
	bool "A bit-bang driver to generate SWD sequence"
	default $(dt_compat_enabled,$(DT_COMPAT_ZPROBE_SWDIO_BITBANG))
	select HAS_SWDIO
	select GPIO
```

## app/drivers/usb/Kconfig
```kconfig
# Copyright (c) 2023 XiNGRZ
# SPDX-License-Identifier: Apache-2.0

rsource "device/Kconfig"
```
